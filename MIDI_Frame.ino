//MIDI Frame main code
//#include <toneAC.h>

#define DEBUG 0

//Lightning Lipgloss Life MIDI as Array
unsigned char Midi1[] = {
  0x4d, 0x54, 0x68, 0x64, 0x00, 0x00, 0x00, 0x06, 0x00, 0x00, 0x00, 0x01,
  0x00, 0x60, 0x4d, 0x54, 0x72, 0x6b, 0x00, 0x00, 0x0a, 0x28, 0x00, 0xff,
  0x03, 0x0e, 0x49, 0x6e, 0x73, 0x74, 0x20, 0x31, 0x2a, 0x6a, 0x6f, 0x69,
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  0x54, 0x40, 0x00, 0xff, 0x2f, 0x00
};
unsigned int Midi1_len = 2622;

unsigned int Ptr, EndBlock; //MIDI parse pointer
const int fs = 44100; //sample rate in Hz
//uint8_t audio*;  //pointer to audio array
long* midiNotes;  //Array of MIDI note vals
float* midiDurs;  //Array of MIDI note durations corresponding to midiNotes
unsigned int MPtr;
const long MThd = 0x4D546864;
const long MTrk = 0x4D54726B;
unsigned long Tempo = 500000;    // Default - microseconds per beat; ie 120bpm
unsigned int TempoDivisor;

/*
Skips over the specified number of bytes in the file
Updates the pointer to its new position
*/
void readIgnore(int n) {
  Ptr = Ptr + n;
}

/*
Read a number with n-byte precision, with n<=4
*/
unsigned long readNumber(int n) {
  long result = 0;
  for (int i=0; i<n; i++) {
    result = (result<<8) + pgm_read_byte(&Midi1[Ptr]);
  }
  return result;
}

/*
Read a variable length number
*/
unsigned long readVariable() {
  long result = 0;
  uint8_t b;
  do {
    b = pgm_read_byte(&Midi1[Ptr++]); //b is the current byte in the MIDI file
    result = (result<<7) + (b & 0x7F);  //move result over to the left by 7 bits and then add the last 7 bits of the current byte
  } while (b & 0x80); //while the first bit of the byte is 1, meaning the VLV continues
  return result;
}

void genAudio(unsigned char MIDI[]) {
  Ptr = 0;            //Start at beginning of file
  MPtr = 0;
  //Read header chunk
  unsigned long type = readNumber(4);     //Read first 4 bits of the MIDI file
  if (type != MThd && DEBUG) Serial.println("Error: MIDI file does not begin with header.");
  unsigned long len = readNumber(4);
  unsigned int format = readNumber(2);
  unsigned int tracks = readNumber(2);
  tracks = 1; //I only care about the first track to make the MIDI note array generation easier
  unsigned int division = readNumber(2);  // Ticks per beat
  if (division & 0x80 && DEBUG) Serial.println("Error: Division is in SMPTE format.");
  TempoDivisor = (long)division*16000/Tempo;    //Not sure why 16000 and Tempo are hardcoded -- maybe you can change the tempo as you see fit
  //Process each track
  for (int t=0; t<tracks; t++) {
    //Read track chunk
    type = readNumber(4);
    if (type != MTrk && DEBUG) Serial.printf("Error: Track %d expected type [MTrk], got type %l", t, type);
    len =  readNumber(4);
    EndBlock= Ptr + len;
    //Parse track
    while (Ptr < EndBlock) {
      unsigned long delta = readVariable();   //time delay since last event (or 0 if at beginning or simultaneous)
      uint8_t event = readNumber(1);
      uint8_t eventType = event & 0xF0;   //MIDI message status must start with 1, data starts with 0
      //Meta event
      if (event == 0xFF) {
        uint8_t mtype = readNumber(1);
        uint8_t mlen = readNumber(1);
        // Tempo
        if (mtype == 0x51) {
          Tempo = readNumber(mlen);   //Tempo is in units: microseconds/beat
          TempoDivisor = (long)division*16000/Tempo;
        // Ignore other meta events
        } else {
          readIgnore(mlen);
        }
      }
      // Note off - ignored
      else if (eventType == 0x80) {
        uint8_t number = readNumber(1);
        uint8_t velocity = readNumber(1);
      // Note on
      } else if (eventType == 0x90) {
        uint8_t number = readNumber(1);
        uint8_t velocity = readNumber(1); //discard velocity for now
        //Play note
        midiDurs[MPtr] = ((float)delta / (float)division) * (float)Tempo;  //Time in microseconds
        midiNotes[MPtr++] = number;
      // Polyphonic key pressure
      } else if (eventType == 0xA0) readIgnore(2);
      // Controller change
      else if (eventType == 0xB0) readIgnore(2);
      // Program change
      else if (eventType == 0xC0) readIgnore(1);
      // Channel key pressure
      else if (eventType == 0xD0) readIgnore(1);
      // Pitch bend
      else if (eventType == 0xD0) readIgnore(2);
      else if (DEBUG) Serial.println("Midi message eventType error: eventType not recognized.");
    }
    midiNotes[Ptr] = -1;  //Specify when midiNotes array ends
    midiDurs[Ptr] = -1;

    }
  }

void setup() {
  // put your setup code here, to run once:
  Serial.begin(9600);
}

void loop() {
  // put your main code here, to run repeatedly:

}
